/*    Input Scheme:

  0/ - Off
  1/ - White
  2/ - Red
  3/ - Green
  4/ - Blue
  5/ - Rainbow (Broken)

  ![VAL]/ - Set Brightness
  x[VAL]/ - Set Red
  y[VAL]/ - Set Green
  z[VAL]/ - Set Blue

*/

#include "SPI.h"
#include "Adafruit_WS2801.h"

uint8_t dataPin  = 11;    // Yellow wire on Adafruit Pixels
uint8_t clockPin = 13;    // Green wire on Adafruit Pixels

char c;
String read;
char terminator = '/';
int brightness = 255;
int brightnessPin = A0;
int brightnessValue;  // variable to store the value coming from the sensor
int brightnessValueOLD;
int rPin = A1;
double rValue;  // variable to store the value coming from the sensor
int rValueOLD;

int gPin = A2;
double gValue;  // variable to store the value coming from the sensor
int gValueOLD;
int bPin = A3;
double bValue;  // variable to store the value coming from the sensor
int bValueOLD;

double r = 1.0;
double g = 1.0;
double b = 1.0;
String rstr, gstr, bstr, brightstr;
Adafruit_WS2801 strip = Adafruit_WS2801((uint16_t)128, (uint16_t)1, dataPin, clockPin);

/*

*/

void setup() {
  brightnessValue = analogRead(brightnessPin);
  brightnessValueOLD = brightnessValue;
  rValue = analogRead(rPin);
  rValueOLD = rValue;
 gValue = analogRead(gPin);
  gValueOLD = gValue;
  bValue = analogRead(bPin);
  bValueOLD = bValue;
  
  strip.begin(); // Start Serial listener

  // Update LED contents, to start they are all 'off'
  strip.show();

  Serial.begin(9600); // set the baud rate
  Serial.setTimeout(-1);
  Serial.println("Ready"); // print "Ready" once

}

void loop() {
  read = "";
  while (Serial.available()) {
    char c = Serial.read();
    read += c;
    delay(2);
  }
  if (read.length() > 0 && read.substring(0,1) == "X") {
    rainbow(10);
    rainbowCycle(10);
    Serial.println("Cycling rainbow");
  } else if (read.length() > 0 && read.substring(0,1) == "!") {
    brightstr = read.substring(1);
    brightness = brightstr.toInt();
  } else if (read.length() > 0 && read.substring(0,1) == "+") {

    //
    int indexSlash = read.indexOf('/');
    rstr = read.substring(1, indexSlash);

    read = read.substring(indexSlash + 1);
    indexSlash = read.indexOf('/');


    gstr = read.substring(0, indexSlash);

    read = read.substring(indexSlash + 1);;

    bstr = read.substring(0);

    r = rstr.toDouble() / 255;
    g = gstr.toDouble() / 255;
    b = bstr.toDouble() / 255;
  } else if (read.length() > 0 && read.substring(0,1) == "r") {
    r = read.substring(1).toInt()/255;
  } else if (read.length() > 0 && read.substring(0,1) == "g") {
    g = read.substring(1).toInt()/255;
  } else if (read.length() > 0 && read.substring(0,1) == "b") {
    b = read.substring(1).toInt()/2;
  }

  /*
    //Serial.println("Loop Start");
    int recieved;
    int index;
    //Serial.println(recieved);
    // only send data back if data has been sent
    if (Serial.available() > 0) {
    //recieved = Serial.read();//Until(terminator); // read the incoming data into String until terminator (/) is read
    }
    Serial.println(recieved); // send the data back in a new line so that it is not all one long line, for debug purposes, to be excluded in final version

    recieved = 1;
    if (recieved == 0) { // command to turn off

    r = 0;  //Set RG values
    g = 0;
    b = 0;

    for (index = 0; index < 128; index++) { //Go through each led
      strip.setPixelColor(index, r * brightness, g * brightness, b * brightness); // Set it to updated RGB value
    }
    Serial.println("Strip turned off");           // Turn Strip off
    } else if (recieved == 1) {
  */
  //r = 1;
  //g = 1;
  //b = 1;
  for (int index = 0; index < 128; index++) {
    strip.setPixelColor(index, r * brightness, g * brightness, b * brightness);
  }
  /*
    Serial.println("Strip turned on");    // Turn Strip on (all white)
    } else if (recieved == 2) {
    r = 1;
    g = 0;
    b = 0;
    for (index = 0; index < 128; index++) {
    strip.setPixelColor(index, r * brightness, g * brightness, b * brightness);
    }

    Serial.println("Strip now red");    // Turn Strip to red
    } else if (recieved == 3) {
    r = 0;
    g = 1;
    b = 0;
    for (index = 0; index < 128; index++) {
    strip.setPixelColor(index, r * brightness, g * brightness, b * brightness);
    }
    Serial.println("Strip now green");    // Turn Strip to green
    } else if (recieved == 4) {
    r = 0;
    g = 0;
    b = 1;
    for (index = 0; index < 128; index++) {
    strip.setPixelColor(index, r * brightness, g * brightness, b * brightness);
    }
    Serial.println("Strip now blue");    // Turn Strip to blue
    }
    else if (recieved == 5)
    {
    rainbowCycle(10);
    Serial.println("Strip now cycling Rainbow Colors");    // Turn Strip to cycling rainbow colors
    /*  } else if (recieved.substring(0, 1) == '!') {     //If the first character is a flag symbol, go into setBrightness mode
    brightness = recieved.substring(1).toInt();     //Set brightness to the value after the flag

    } else if (recieved.substring(0, 1) == 'x' || recieved.substring(0, 1) == 'y' || recieved.substring(0, 1) == 'z') { //If the first char is RGB flag (X/Y/Z), set the color to corresponding value
    setRGBVal(recieved.substring(0, 1), recieved.substring(1).toInt()); //Flag and Value to method to figure out
    }
    else if (recieved == 6)
    {
    r = Serial.parseFloat();
    }
    else if (recieved == 7)
    {
    g = Serial.parseFloat();
    }
    else if (recieved == 8)
    {
    b = Serial.parseFloat();
    }
    else
    {
    Serial.println("No sense");
    }
    strip.show(); //Update strip after all is done
    Serial.println("Loop ran");
    //setup();
    delay(100); //Delay for a while
    //recieved = "";         //Reset reader

  */

  /*brightnessValue = analogRead(brightnessPin);
  // turn the ledPin on
  if (brightnessValue >= brightnessValueOLD + 4 || brightnessValue <=  brightnessValueOLD - 4) {
    brightness = map(brightnessValue, 0, 1023, 0, 255);
    //Serial.println(brightnessValue);
    brightnessValueOLD = brightnessValue;
  }
  
  
  rValue = analogRead(rPin);
  // turn the ledPin on
  if (rValue >= rValueOLD + 4 || rValue <=  rValueOLD - 4) {
    r = rValue/1023;
    //Serial.println(r);
     rValueOLD = rValue;
  }
  
  gValue = analogRead(gPin);
  // turn the ledPin on
  if (gValue >= gValueOLD + 4 || gValue <=  gValueOLD - 4) {
    g = gValue/1023;
    Serial.println(g);
    gValueOLD = gValue;
  }
  
  
  bValue = analogRead(bPin);
  // turn the ledPin on
  if (bValue >= bValueOLD + 4 || bValue <=  bValueOLD - 4) {
    b = bValue/1023;
    //Serial.println(r);
     bValueOLD = bValue;
  }*/



  for (int index = 0; index < 128; index++) {
    strip.setPixelColor(index, r * brightness, g * brightness, b * brightness);
  }
  strip.show();
}



void rainbow(uint8_t wait) {
  int i, j;
   
  for (j=0; j < 256; j++) {     // 3 cycles of all 256 colors in the wheel
    for (i=0; i < strip.numPixels(); i++) {
      strip.setPixelColor(i, Wheel( (i + j) % 255));
    }  
    strip.show();   // write all the pixels out
    delay(wait);
  }
}

// Slightly different, this one makes the rainbow wheel equally distributed 
// along the chain
void rainbowCycle(uint8_t wait) {
  int i, j;
  
  for (j=0; j < 256 * 5; j++) {     // 5 cycles of all 25 colors in the wheel
    for (i=0; i < strip.numPixels(); i++) {
      // tricky math! we use each pixel as a fraction of the full 96-color wheel
      // (thats the i / strip.numPixels() part)
      // Then add in j which makes the colors go around per pixel
      // the % 96 is to make the wheel cycle around
      strip.setPixelColor(i, Wheel( ((i * 256 / strip.numPixels()) + j) % 256) );
    }  
    strip.show();   // write all the pixels out
    delay(wait);
  }
}

// fill the dots one after the other with said color
// good for testing purposes
void colorWipe(uint32_t c, uint8_t wait) {
  int i;
  
  for (i=0; i < strip.numPixels(); i++) {
      strip.setPixelColor(i, c);
      strip.show();
      delay(wait);
  }
}

/* Helper functions */

// Create a 24 bit color value from R,G,B
uint32_t Color(byte r, byte g, byte b)
{
  uint32_t c;
  c = r;
  c <<= 8;
  c |= g;
  c <<= 8;
  c |= b;
  return c;
}

//Input a value 0 to 255 to get a color value.
//The colours are a transition r - g -b - back to r
uint32_t Wheel(byte WheelPos)
{
  if (WheelPos < 85) {
   return Color(WheelPos * 3, 255 - WheelPos * 3, 0);
  } else if (WheelPos < 170) {
   WheelPos -= 85;
   return Color(255 - WheelPos * 3, 0, WheelPos * 3);
  } else {
   WheelPos -= 170; 
   return Color(0, WheelPos * 3, 255 - WheelPos * 3);
  }
}

/*
  a	0
  b	1
  c	2
  d	3
  e	4
  f	5
  g	6
  h	7
  i	8
  j	9

  x   RED
  y   GREEN
  z   BLUE
  !   Brightness
*/

/*int setBrightness() {*/                                                     //Old, broken set brightness function
/*Serial.println("Set Brightness mode");
  while (Serial.read() != '/') {}
  Serial.println("Set hundreds");
  while (Serial.read() == '/') {}
  int hbit = Serial.read();
  Serial.println(hbit);
  while (Serial.read() != '/') {}
  Serial.println("Set tens");
  while (Serial.read() == '/') {}
  int tbit = Serial.read();
  Serial.println(hbit);
  while (Serial.read() != '/') {}
  Serial.println("Set ones");
  while (Serial.read() == '/') {}
  int obit = Serial.read();
  Serial.println(hbit);
  int hundreds = charToNum(hbit);
  int tens = charToNum(tbit);
  int ones = charToNum(obit);
  brightness = (hundreds*100 + tens*10 + ones) * -1;
  Serial.print("Brightness set to ");
  Serial.println(brightness);
  for (int index = 0; index < 128; index++) {
  strip.setPixelColor(index, r * brightness, g * brightness, b * brightness);
  }
  strip.show();*/
/*  char temp = Serial.read();
  Serial.println("Set Brightness mode");
  Serial.println("Set hundreds");
  while(!Serial.available()) {}
  char hbit = Serial.read();
  Serial.println(hbit);

  Serial.println("Set tens");
  while(!Serial.available()) {}
  char tbit = Serial.read();
  Serial.println(tbit);

  Serial.println("Set ones");
  while(!Serial.available()) {}
  char obit = Serial.read();
  Serial.println(obit);
  int hundreds = charToNum(hbit);
  int tens = charToNum(tbit);
  int ones = charToNum(obit);
  brightness = hundreds*100 + tens*10 + ones;
  Serial.print("Brightness set to ");
  Serial.println(brightness);
  for (int index = 0; index < 128; index++) {
    strip.setPixelColor(index, r * brightness, g * brightness, b * brightness);
  }
  strip.show();
  }*/

int setRGBVal(String color, int val) {                                            //Function to set RGB to input val
  int rbit, gbit, bbit;
  if (color == 'x') {   //if input flag is x, set red
    r = val;
  }
  if (color == 'y') {   //if input flag is y, set green
    g = val;
  }
  if (color == 'z') {   //if input flag is z, set blue
    b = val;
  }
  for (int index = 0; index < 128; index++) {
    strip.setPixelColor(index, r * brightness, g * brightness, b * brightness);
  }
  strip.show();
}

int charToNum(char bit) {     //Old function for old input met
  if (bit == 'a') {
    return 0;
  } else if (bit == 'b') {
    return 1;
  } else if (bit == 'c') {
    return 2;
  } else if (bit == 'd') {
    return 3;
  } else if (bit == 'e') {
    return 4;
  } else if (bit == 'f') {
    return 5;
  } else if (bit == 'g') {
    return 6;
  } else if (bit == 'h') {
    return 7;
  } else if (bit == 'i') {
    return 8;
  } else if (bit == 'j') {
    return 9;
  }
}





